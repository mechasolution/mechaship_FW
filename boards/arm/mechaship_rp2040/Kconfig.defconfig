## boards/arm/mechaship_rp2040/Kconfig.defconfig
```kconfig
# SPDX-License-Identifier: Apache-2.0

if BOARD_MECHASHIP_RP2040

if I2C_DW
config I2C_DW_CLOCK_SPEED
	default 125
endif

config USB_SELF_POWERED
	default n

endif
```

## boards/arm/mechaship_rp2040/Kconfig.mechaship_rp2040
```kconfig
# SPDX-License-Identifier: Apache-2.0

config BOARD_MECHASHIP_RP2040
	select SOC_RP2040
```

## boards/arm/mechaship_rp2040/board.yml
```yaml
board:
  name: mechaship_rp2040
  full_name: Mechaship RP2040 Mainboard
  vendor: mechaship
  socs:
    - name: rp2040
```
